## rockchip_rk3566_defconfig
```kconfig
#include "base.config"
#include "base_extra.config"sia/Shanghai
#include "benchmark.config"
#include "debug.config"
#include "debug2.config"
#include "network.config"
#include "ntfs.config"
#include "powermanager.config"
#include "rk356x_arm64.config"
#include "test.config"
#include "wifi.config"
#include "bt.config"
#include "gpu.config"
#include "video_mpp.config"
BR2_TARGET_SERIAL_SHELL_GETTY=y
BR2_TARGET_GENERIC_GETTY_PORT="tty1"
BR2_TARGET_LOCALTIME="Asia/Shanghai"
BR2_PACKAGE_RKWIFIBT_AMPAKALL=y
BR2_PACKAGE_RKWIFIBT_BTUART="ttyS1"
BR2_PACKAGE_DEVICEIO_RELEASE=y
BR2_PACKAGE_FIREFLY=y
BR2_PACKAGE_QUECTEL_CM=y
BR2_PACKAGE_BLKTRACE=y
BR2_PACKAGE_DSTAT=y
BR2_PACKAGE_LSOF=y
BR2_PACKAGE_LTRACE=y
BR2_PACKAGE_LIBTOOL=y
BR2_PACKAGE_IOSTAT=y
BR2_PACKAGE_LIBVORBIS=y
BR2_PACKAGE_CA_CERTIFICATES=y
BR2_PACKAGE_OPENSSL=y
BR2_PACKAGE_LIBOPENSSL_BIN=y
BR2_PACKAGE_LIBOPENSSL_ENGINES=y
BR2_PACKAGE_REDIS=y
BR2_PACKAGE_LIBXKBCOMMON=y
BR2_PACKAGE_LIBCURL=y
BR2_PACKAGE_LIBCURL_CURL=y
BR2_PACKAGE_LIBCURL_VERBOSE=y
BR2_PACKAGE_LIBSOUP=y
BR2_PACKAGE_RTMPDUMP=y
BR2_PACKAGE_PCRE2=y
BR2_PACKAGE_PCRE2_16=y
BR2_PACKAGE_K3S=y
BR2_PACKAGE_CONNTRACK_TOOLS=y
BR2_PACKAGE_IPTABLES=y
BR2_PACKAGE_IPTABLES_NFTABLES=y
BR2_PACKAGE_MOSQUITTO=y
BR2_PACKAGE_NETCAT_OPENBSD=y
BR2_PACKAGE_RSYNC=y
BR2_PACKAGE_WGET=y
BR2_PACKAGE_HTOP=y
BR2_PACKAGE_IOTOP=y
BR2_PACKAGE_RUNC=y
BR2_PACKAGE_EDGEX_GO=y
BR2_PACKAGE_DEVICE_VIRTUAL_GO=y
BR2_PACKAGE_APP_SERVICE_CONFIGURABLE=y
BR2_PACKAGE_EKUIPER=y
BR2_PACKAGE_CONSUL=y
BR2_PACKAGE_DEVICE_ZHONGHONG_GO=y
```
